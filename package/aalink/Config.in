## package/aalink/Config.in
```kconfig
config BR2_PACKAGE_AALINK
	bool "aalink"
	help
	  aalink - adaptive link binary distribution.

	  Installs:
	    - /usr/bin/aalink
	    - /etc/aalink.conf
	    - SysV init script: /etc/init.d/S99aalink

	  https://github.com/sickgreg/OpenIPC_sickgregFPV_apfpv
```

## package/autod/Config.in
```kconfig
config BR2_PACKAGE_AUTOD
	bool "autod"
	help
	  autod - small C daemon (includes civetweb/parson) with a VRX web UI.

	  Installs:
	    - /usr/bin/autod
	    - /etc/autod/autod.conf
	    - /usr/share/autod/vtx

	  Provides:
	    - SysV init script: /etc/init.d/S99autod

	  https://github.com/snokvist/autod
```

## package/flashd/Config.in
```kconfig
config BR2_PACKAGE_FLASHD
	bool "flashd"
	depends on BR2_TOOLCHAIN_HAS_THREADS
	help
	  Vendor-neutral on-device firmware flasher (Mode A agent).
	  Serves a WebUI on :8070, browses firmware from the configured
	  sources (waybeam-releases manifest), verifies the image locally
	  and drives OpenIPC sysupgrade. Pre-built binary from
	  waybeam-releases.

	  Installs:
	    - /usr/bin/flashd
	    - /etc/flashd.json        (board_override stamped per SoC)
	    - /etc/flashd/sources.json
	    - /etc/init.d/S98flashd
```

## package/sigmastar-osdrv-infinity6e-libs/Config.in
```kconfig
config BR2_PACKAGE_SIGMASTAR_OSDRV_INFINITY6E_LIBS
	bool "sigmastar-osdrv-infinity6e userspace libs"
	help
	  Installs the prebuilt SigmaStar Infinity6E userspace MI libraries
	  from OpenIPC/firmware into:
	    - staging: /usr/lib (for linking)
	    - target:  /usr/lib (for runtime)
```

## package/waybeam-distribution-star6c/Config.in
```kconfig
config BR2_PACKAGE_WAYBEAM_DISTRIBUTION_STAR6C
	bool "waybeam-distribution-star6c"
	help
	  Waybeam distribution package for Infinity6C (SSC378QE).
	  Platform-specific assets not distributed by other packages.
```

## package/waybeam-distribution-star6e/Config.in
```kconfig
config BR2_PACKAGE_WAYBEAM_DISTRIBUTION_STAR6E
	bool "waybeam-distribution-star6e"
	help
	  Waybeam distribution package for Infinity6E (SSC338Q/SSC30KQ).
	  Sensor tuning profiles and platform-specific assets.

	  Installs:
	    - /etc/sensors/imx335_greg_fpvVII-gpt200.bin
	    - /etc/sensors/imx415_greg_fpvXVIII-gpt200.bin
```

## package/waybeam-distribution/Config.in
```kconfig
config BR2_PACKAGE_WAYBEAM_DISTRIBUTION
	bool "waybeam-distribution"
	help
	  Waybeam distribution package — sensor configs, firmware assets,
	  and other files not distributed by individual Waybeam packages.

	  Installs:
	    - /etc/sensors/*.bin (IMX335/IMX415 tuning profiles)
```

## package/waybeam-hub/Config.in
```kconfig
config BR2_PACKAGE_WAYBEAM_HUB
	bool "waybeam-hub"
	depends on BR2_TOOLCHAIN_HAS_THREADS
	select BR2_PACKAGE_SIGMASTAR_OSDRV_INFINITY6E_LIBS
	help
	  Modular C daemon for the Waybeam FPV ecosystem.
	  Vehicle build: OSD overlay (LVGL+MI_RGN), telemetry bridge,
	  PWM servo, SSE server, WebUI, menu, metrics, link adaptation.
```

## package/waybeam-osd/Config.in
```kconfig
config BR2_PACKAGE_WAYBEAM_OSD
	bool "waybeam-osd"
	depends on BR2_TOOLCHAIN_HAS_THREADS
	help
	  LVGL-based transparent OSD driven by UDP JSON payloads.

	  Installs:
	    - /usr/bin/waybeam-osd   (renamed from lvgltest)
	    - /etc/waybeam_osd.json  (default config)
	    - /etc/init.d/S96waybeam-osd (SysV init script)
```

## package/waybeam-venc-maruko/Config.in
```kconfig
config BR2_PACKAGE_WAYBEAM_VENC_MARUKO
	bool "waybeam-venc-maruko"
	depends on BR2_TOOLCHAIN_HAS_THREADS
	select BR2_PACKAGE_SIGMASTAR_OSDRV_INFINITY6C
	help
	  Standalone H.265 video encoder & streamer for Infinity6C
	  (SSC378QE/Maruko). Dual-backend, sensor unlock, HTTP API.

	  Installs:
	    - /usr/bin/venc
	    - /etc/venc.json
```

## package/waybeam-venc-star6e/Config.in
```kconfig
config BR2_PACKAGE_WAYBEAM_VENC_STAR6E
	bool "waybeam-venc-star6e"
	depends on BR2_TOOLCHAIN_HAS_THREADS
	help
	  Standalone H.265 video encoder & streamer for Infinity6E
	  (SSC338Q/SSC30KQ). Dual-backend, sensor unlock, HTTP API.

	  Installs:
	    - /usr/bin/venc
	    - /etc/venc.json
```

## package/wfb-air/Config.in
```kconfig
config BR2_PACKAGE_WFB_AIR
	bool "wfb-air (waybeam_wfb_ng mega binary)"
	depends on BR2_TOOLCHAIN_HAS_THREADS
	select BR2_PACKAGE_LIBSODIUM
	help
	  Vehicle (air) build of the waybeam_wfb_ng "mega binary": a single
	  busybox-style multicall ELF that provides all wfb-ng roles as
	  applets (link controller, tx, rx, tx_cmd, keygen) plus self-config
	  from /etc/wfb-link.json and auto-keygen. Replaces the stock
	  wfb-bins-only package (separate wfb_tx/wfb_rx/... binaries).

	  Pre-built binary from waybeam-releases. libpcap is static-linked;
	  libsodium (so.23) and libstdc++ are dynamic (libstdc++ ships with
	  the base rootfs).

	  Installs:
	    - /usr/bin/wfb-air
	    - /etc/wfb-link.json     (vehicle preset)
	    - /etc/wfb-common.sh     (shared init helpers)
	    - /etc/init.d/S99wfb     (wfbmode-gated broadcaster startup)
```
